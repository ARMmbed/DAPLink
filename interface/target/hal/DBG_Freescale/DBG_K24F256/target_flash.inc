/* CMSIS-DAP Interface Firmware
 * Copyright (c) 2009-2013 ARM Limited
 *
 * Licensed under the Apache License, Version 2.0 (the "License");
 * you may not use this file except in compliance with the License.
 * You may obtain a copy of the License at
 *
 *     http://www.apache.org/licenses/LICENSE-2.0
 *
 * Unless required by applicable law or agreed to in writing, software
 * distributed under the License is distributed on an "AS IS" BASIS,
 * WITHOUT WARRANTIES OR CONDITIONS OF ANY KIND, either express or implied.
 * See the License for the specific language governing permissions and
 * limitations under the License.
 */

#include "target_flash.h"

const uint32_t K24F256_FLM[] = {
    0xE00ABE00, 0x062D780D, 0x24084068, 0xD3000040, 0x1E644058, 0x1C49D1FA, 0x2A001E52, 0x4770D1F2,
    0xb510482d, 0x5120f24c, 0xf64d81c1, 0x81c11128, 0xf0218801, 0x80010101, 0x44484828, 0xf8a4f000,
    0xd0002800, 0xbd102001, 0x47702000, 0xb5104823, 0x44484923, 0xf884f000, 0x4820b920, 0x44482100,
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    0x00400000, 0x00800000, 0x01000000, 0x01000000, 0x40020004, 0x00000000,
};

static const TARGET_FLASH flash = {
    0x20000021, // Init
    0x20000049, // UnInit
    0x2000004D, // EraseChip
    0x20000071, // EraseSector
    0x2000009F, // ProgramPage

    // breakpoint = RAM start + 1
    // RSB : base address is address of Execution Region PrgData in map file
    //       to access global/static data
    // RSP : Initial stack pointer
    {
        0x20000001, // breakpoint instruction address
        0x20000000 + 0x20 + 0x3f4,  // static base register value (image start + header + static base offset)
        0x20000800  // initial stack pointer
    },

    0x20001000, // program_buffer, any valid RAM location with +512 bytes of headroom
    0x20000000, // algo_start, start of RAM
    sizeof(K24F256_FLM), // algo_size, size of array above
    K24F256_FLM,  // image, flash algo instruction array
    512        // ram_to_flash_bytes_to_be_written
};

