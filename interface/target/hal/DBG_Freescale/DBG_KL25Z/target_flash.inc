/* CMSIS-DAP Interface Firmware
 * Copyright (c) 2009-2013 ARM Limited
 *
 * Licensed under the Apache License, Version 2.0 (the "License");
 * you may not use this file except in compliance with the License.
 * You may obtain a copy of the License at
 *
 *     http://www.apache.org/licenses/LICENSE-2.0
 *
 * Unless required by applicable law or agreed to in writing, software
 * distributed under the License is distributed on an "AS IS" BASIS,
 * WITHOUT WARRANTIES OR CONDITIONS OF ANY KIND, either express or implied.
 * See the License for the specific language governing permissions and
 * limitations under the License.
 */

#include "target_flash.h"

static const uint32_t KL25Z_FLM[] = {
    0xE00ABE00, 0x062D780D, 0x24084068, 0xD3000040, 0x1E644058, 0x1C49D1FA, 0x2A001E52, 0x4770D1F2,
    0x4770ba40, 0x4770ba40, 0x4770ba40, 0x4770ba40, 0x4770ba40, 0x4770ba40, 0x4770ba40, 0x4770ba40, 
    0x4770ba40, 0x4770ba40, 0x4770bac0, 0x4770bac0, 0x4770bac0, 0x4770bac0, 0x4770bac0, 0x4770bac0, 
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    0x40020004, 0x00000000, 
};

static const TARGET_FLASH flash = {
    0x20000071, // Init
    0x20000089, // UnInit
    0x2000008D, // EraseChip
    0x200000B5, // EraseSector
    0x200000E7, // ProgramPage

    // breakpoint = RAM start + 1
    // RSB : base address is address of Execution Region PrgData in map file
    //       to access global/static data
    // RSP : Initial stack pointer
	{
	    0x20000001, // breakpoint instruction address
	    0x20000000 + 0x20 + 0x3a4,  // static base register value (image start + header + static base offset)
	    0x20000800  // initial stack pointer
	},

	0x20000a00, // program_buffer, any valid RAM location with +512 bytes of headroom
	0x20000000, // algo_start, start of RAM
	sizeof(KL25Z_FLM), // algo_size, size of array above
	KL25Z_FLM,  // image, flash algo instruction array
    512        // ram_to_flash_bytes_to_be_written
};


